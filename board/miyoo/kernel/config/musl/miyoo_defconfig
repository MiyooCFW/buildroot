## configs/miyoo_uclibc_static_defconfig
```kconfig
BR2_arm=y
BR2_SVN="svn"
BR2_CPAN_MIRROR="http://cpan.metacpan.org"
BR2_CCACHE=y
BR2_STATIC_LIBS=y
BR2_PER_PACKAGE_DIRECTORIES=y
BR2_TOOLCHAIN_BUILDROOT_VENDOR="miyoo"
BR2_TOOLCHAIN_BUILDROOT_WCHAR=y
BR2_PTHREAD_DEBUG=y
BR2_GCC_VERSION_9_X=y
BR2_TOOLCHAIN_BUILDROOT_CXX=y
BR2_GCC_ENABLE_LTO=y
BR2_TARGET_OPTIMIZATION="-mcpu=arm926ej-s -marm"
BR2_TARGET_GENERIC_HOSTNAME="miyoo"
BR2_TARGET_GENERIC_ISSUE="Welcome to Miyoo"
BR2_INIT_NONE=y
# BR2_TARGET_ENABLE_ROOT_LOGIN is not set
# BR2_TARGET_GENERIC_GETTY is not set
# BR2_TARGET_GENERIC_REMOUNT_ROOTFS_RW is not set
# BR2_PACKAGE_BUSYBOX is not set
BR2_PACKAGE_ALSA_UTILS=y
BR2_PACKAGE_ALSA_UTILS_APLAY=y
BR2_PACKAGE_ALSA_UTILS_SPEAKER_TEST=y
BR2_PACKAGE_FFMPEG=y
BR2_PACKAGE_FFMPEG_GPL=y
BR2_PACKAGE_FFMPEG_FFPLAY=y
BR2_PACKAGE_FFMPEG_FFPROBE=y
BR2_PACKAGE_FFMPEG_AVRESAMPLE=y
BR2_PACKAGE_FFMPEG_POSTPROC=y
BR2_PACKAGE_FFMPEG_ENCODERS="aac ac3 flac jpegls libx264 libx264rgb libopus mpeg1video mpeg2video mpeg4 pcm_s16be pcm_s16le pcm_s16le_planar png rawvideo vorbis wavpack zlib"
BR2_PACKAGE_FFMPEG_DECODERS="aac ac3 flac jpegls libopus mp2 mp3 mpeg1video mpeg2video mpeg4 mpegvideo png h264 hevc vc1 opus pcm_s16be pcm_s16le pcm_s16le_planar rawvideo vorbis wavpack yuv4 zlib"
BR2_PACKAGE_FFMPEG_MUXERS="ac3 avi flac ffm h264 hevc matroska ogg opus mov mp3 mp4 mpeg1video mpeg2video mpegts m4v pcm_s16be pcm_s16le rawvideo rtp wav yuv4mpegpipe"
BR2_PACKAGE_FFMPEG_DEMUXERS="aac avi h264 flac matroska mov mp3 mpegps mpegts mpegvideo ogg pcm_s16be pcm_s16le rawvideo wav yuv4mpegpipe"
BR2_PACKAGE_FFMPEG_PARSERS="aac flac ac3 h264 hevc mpegaudio mpeg4video mpegvideo opus vc1 vorbis"
BR2_PACKAGE_FFMPEG_BSFS=""
BR2_PACKAGE_FFMPEG_PROTOCOLS="file"
BR2_PACKAGE_FFMPEG_EXTRACONF="--enable-small"
BR2_PACKAGE_FLUIDLITE=y
BR2_PACKAGE_MPG123=y
BR2_PACKAGE_VORBIS_TOOLS=y
BR2_PACKAGE_BZIP2=y
BR2_PACKAGE_P7ZIP=y
BR2_PACKAGE_ZIP=y
BR2_PACKAGE_STRACE=y
BR2_PACKAGE_GETTEXT=y
BR2_PACKAGE_LIBTOOL=y
BR2_PACKAGE_FBGRAB=y
BR2_PACKAGE_SDL_GFX=y
BR2_PACKAGE_SDL_IMAGE=y
BR2_PACKAGE_SDL_IMAGE_GIF=y
BR2_PACKAGE_SDL_IMAGE_JPEG=y
BR2_PACKAGE_SDL_IMAGE_LBM=y
BR2_PACKAGE_SDL_IMAGE_PCX=y
BR2_PACKAGE_SDL_IMAGE_PNG=y
BR2_PACKAGE_SDL_IMAGE_PNM=y
BR2_PACKAGE_SDL_IMAGE_TARGA=y
BR2_PACKAGE_SDL_IMAGE_TIFF=y
BR2_PACKAGE_SDL_IMAGE_WEBP=y
BR2_PACKAGE_SDL_IMAGE_XCF=y
BR2_PACKAGE_SDL_IMAGE_XPM=y
BR2_PACKAGE_SDL_IMAGE_XV=y
BR2_PACKAGE_SDL_MIXER=y
BR2_PACKAGE_SDL_MIXER_MIDI_TIMIDITY=y
BR2_PACKAGE_SDL_NET=y
BR2_PACKAGE_SDL_SOUND=y
BR2_PACKAGE_SDL_SOUND_PLAYSOUND=y
BR2_PACKAGE_SDL_TTF=y
BR2_PACKAGE_LUA=y
BR2_PACKAGE_LUA_5_1=y
BR2_PACKAGE_LIBASPLIB=y
BR2_PACKAGE_LIBID3TAG=y
BR2_PACKAGE_LIBMAD=y
BR2_PACKAGE_LIBMIKMOD=y
BR2_PACKAGE_LIBSNDFILE=y
BR2_PACKAGE_OPENAL=y
BR2_PACKAGE_SPEEX=y
BR2_PACKAGE_TREMOR=y
BR2_PACKAGE_LZ4=y
BR2_PACKAGE_LIBSHA1=y
BR2_PACKAGE_LIBCONFUSE=y
BR2_PACKAGE_GIFLIB=y
BR2_PACKAGE_LIBDRM=y
BR2_PACKAGE_LIBSVG_CAIRO=y
BR2_PACKAGE_PANGO=y
BR2_PACKAGE_LIBPCIACCESS=y
BR2_PACKAGE_LIBUSBGX=y
BR2_PACKAGE_TSLIB=y
BR2_PACKAGE_JSON_C=y
BR2_PACKAGE_LIBXMLPP=y
BR2_PACKAGE_LIBXMLRPC=y
BR2_PACKAGE_TINYXML=y
BR2_PACKAGE_TINYXML2=y
BR2_PACKAGE_YAML_CPP=y
BR2_PACKAGE_LIBASS=y
BR2_PACKAGE_LIBTHEORA=y
BR2_PACKAGE_X264=y
BR2_PACKAGE_ARGP_STANDALONE=y
BR2_PACKAGE_BOOST=y
BR2_PACKAGE_XUTIL_UTIL_MACROS=y
BR2_PACKAGE_GMENU2X_GM2XPKG=y
BR2_PACKAGE_OPKG=y
BR2_PACKAGE_URANDOM_SCRIPTS=y
BR2_PACKAGE_BASH=y
BR2_PACKAGE_DIALOG=y
BR2_PACKAGE_UTIL_LINUX_LIBMOUNT=y
BR2_PACKAGE_NANO=y
# BR2_TARGET_ROOTFS_TAR is not set
BR2_PACKAGE_HOST_DOSFSTOOLS=y
BR2_PACKAGE_HOST_E2FSPROGS=y
BR2_PACKAGE_HOST_GENIMAGE=y
BR2_PACKAGE_HOST_KMOD=y
BR2_PACKAGE_HOST_MTOOLS=y
BR2_PACKAGE_HOST_UBOOT_TOOLS=y
BR2_PACKAGE_HOST_UBOOT_TOOLS_FIT_SUPPORT=y
BR2_PACKAGE_HOST_UBOOT_TOOLS_FIT_SIGNATURE_SUPPORT=y
BR2_PACKAGE_HOST_UBOOT_TOOLS_BOOT_SCRIPT=y
BR2_PACKAGE_HOST_UBOOT_TOOLS_BOOT_SCRIPT_SOURCE="board/miyoo/boot.cmd"
```

## package/directfb2/Config.in
```kconfig
config BR2_PACKAGE_DIRECTFB2
	bool "directfb2"
	depends on !BR2_PACKAGE_DIRECTFB
	select BR2_PACKAGE_FLUX
	help
	  DirectFB2 is a fork of DirectFB.

config BR2_PACKAGE_DIRECTFB2_MULTI
	bool "enable multiple application support"
	depends on BR2_PACKAGE_DIRECTFB2

config BR2_PACKAGE_DIRECTFB2_MULTI_KERNEL
	bool "Enable Linux fusion device support for multi application"
	select BR2_PACKAGE_DIRECTFB2_MULTI

config BR2_PACKAGE_DIRECTFB2_DRMKMS
	bool "DRM/KMS backend"
	depends on BR2_PACKAGE_DIRECTFB2
	select BR2_PACKAGE_LIBDRM

config BR2_PACKAGE_DIRECTFB2_FBDEV
	bool "fbdev backend"
	depends on BR2_PACKAGE_DIRECTFB2
```

## package/djvu/Config.in
```kconfig
config BR2_PACKAGE_DJVU
	bool "djvulibre"
	help
	  DjVuLibre is an open source (GPL'ed) project of DjVu.

	  https://djvu.sourceforge.net/
```

## package/fatresize/Config.in
```kconfig
config BR2_PACKAGE_FATRESIZE
	depends on BR2_PACKAGE_PARTED
	bool "fatresize"
	help
	  Resize fat partitions
```

## package/fluidlite/Config.in
```kconfig
config BR2_PACKAGE_FLUIDLITE
	bool "fluidlite"
	depends on BR2_USE_MMU
	help
	  FluidLite is a very light version of FluidSynth.
```

## package/gmenu2x-gm2xpkg/Config.in
```kconfig
config BR2_PACKAGE_GMENU2X_GM2XPKG
	bool "gmenu2x-gm2xpkg"
	help
	  This is a GMenu2X PacKaGer aka "gm2xpkg" released under the GNU GPL license v2.
	  Designed to archive/package your apps for further distribution, supports dir/zip/ipk formats.
```

## package/gstreamer1/gst-fbdev2-plugins/Config.in
```kconfig
config BR2_PACKAGE_GST_FBDEV2_PLUGINS
	bool "gst-fbdev2-plugins"
	depends on BR2_PACKAGE_LIBCEDARC
	select BR2_PACKAGE_GST1_PLUGINS_BASE
	help
	  GStreamer plug-in to use sunxifbsink
```

## package/gstreamer1/gst-omx/Config.in
```kconfig
config BR2_PACKAGE_GST_OMX
	bool "gst-omx"
	depends on BR2_PACKAGE_HAS_LIBOPENMAX || \
		BR2_PACKAGE_LIBCEDARC
	select BR2_PACKAGE_GST1_PLUGINS_BASE
	help
	  GStreamer plug-in to use OpenMAX API.

	  https://cgit.freedesktop.org/gstreamer/gst-omx

comment "gst-omx requires a libopenmax or libcedarc implementation"
	depends on !BR2_PACKAGE_HAS_LIBOPENMAX && \
		!BR2_PACKAGE_LIBCEDARC
```

## package/ipk-drpocketsnes/Config.in
```kconfig
config BR2_PACKAGE_IPK_DRPOCKETSNES
    bool "DrPocketSNES IPK"
    help
      SNES emulator optimized for ARM
```

## package/ipk-fceux/Config.in
```kconfig
config BR2_PACKAGE_IPK_FCEUX
    bool "FCEUX IPK"
    help
      FCEUX is a cross platform, NTSC and PAL Famicom/NES and Dendy emulator
```

## package/ipk-gngeo/Config.in
```kconfig
config BR2_PACKAGE_IPK_GNGEO
    bool "GnGeo IPK"
    help
      GNGEO - a NeoGeo emulator
```

## package/ipk-pcsx_rearmed/Config.in
```kconfig
config BR2_PACKAGE_IPK_PCSX_REARMED
    bool "PCSX_REARMED IPK"
    help
      PCSX-ReARMed - yet another PCSX fork
```

## package/joy2key/Config.in
```kconfig
config BR2_PACKAGE_JOY2KEY
	bool "joy2key"
	help
	  Joy2key will translate your joystick movements into the equivilent keystrokes
```

## package/joymap/Config.in
```kconfig
config BR2_PACKAGE_JOYMAP
	bool "joymap"
	help
	  Joymap will translate your joystick movements into the equivilent keystrokes
```

## package/libretro-arduous/Config.in
```kconfig
config BR2_PACKAGE_LIBRETRO_ARDUOUS
	bool "libretro-arduous"
	depends on BR2_PACKAGE_RETROARCH
	help
	  Arduboy is a portable game based on the Arduino hardware.

	  https://github.com/libretro/arduous
```

## package/libretro-bluemsx/Config.in
```kconfig
config BR2_PACKAGE_LIBRETRO_BLUEMSX
	bool "libretro-bluemsx"
	depends on BR2_PACKAGE_RETROARCH
	help
	  A libretro MSX/ColecoVision/Spectravideo
	  emulator core for ARM.

	  http://www.libretro.com
```

## package/libretro-chailove/Config.in
```kconfig
config BR2_PACKAGE_LIBRETRO_CHAILOVE
	bool "libretro-chailove"
	depends on BR2_PACKAGE_RETROARCH
	help
	  A libretro port of chailove, a game.

	  http://www.libretro.com
```

## package/libretro-cores/Config.in
```kconfig
config BR2_PACKAGE_LIBRETRO_CORES
    bool "retroarch cores"
    help
      Package to fetch, build and install Retroarch cores

      https://github.com/libretro/libretro-super
```

## package/libretro-database/Config.in
```kconfig
config BR2_PACKAGE_LIBRETRO_DATABASE
    bool "retroarch database"
    depends on BR2_PACKAGE_RETROARCH
    help
      RetroArch incoporates a ROM scanning system to automatically produce playlists.
      Each ROM that is scanned by the playlist generator is checked against a database of ROMs that are known to be good copies.

      https://github.com/libretro/libretro-database
```

## package/libretro-ecwolf/Config.in
```kconfig
config BR2_PACKAGE_LIBRETRO_ECWOLF
	bool "libretro-ecwolf"
	depends on BR2_PACKAGE_RETROARCH
	help
	  A libretro Wolfenstein 3D source port game engine.

	  http://www.libretro.com
```
