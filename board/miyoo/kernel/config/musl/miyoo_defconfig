## board/miyoo/kernel/config/musl/miyoo_defconfig
```kconfig
CONFIG_LOCALVERSION="-miyoo"
# CONFIG_LOCALVERSION_AUTO is not set
CONFIG_DEFAULT_HOSTNAME="miyoo"
CONFIG_LOG_BUF_SHIFT=16
CONFIG_PRINTK_SAFE_LOG_BUF_SHIFT=12
CONFIG_CC_OPTIMIZE_FOR_SIZE=y
# CONFIG_BUG is not set
# CONFIG_KALLSYMS is not set
CONFIG_EMBEDDED=y
CONFIG_SLOB=y
# CONFIG_ARCH_MULTI_V7 is not set
CONFIG_ARCH_SUNXI_V5=y
# CONFIG_DEBUG_ALIGN_RODATA is not set
CONFIG_AEABI=y
CONFIG_OABI_COMPAT=y
CONFIG_ARM_APPENDED_DTB=y
CONFIG_ARM_ATAG_DTB_COMPAT=y
CONFIG_CPU_FREQ=y
CONFIG_CPUFREQ_DT=y
CONFIG_CPU_IDLE=y
CONFIG_CPU_IDLE_GOV_MENU=y
CONFIG_ARM_CPUIDLE=y
CONFIG_FPE_FASTFPE=y
CONFIG_STRICT_KERNEL_RWX=y
CONFIG_STRICT_MODULE_RWX=y
# CONFIG_GCC_PLUGINS is not set
CONFIG_MODULES=y
CONFIG_MODULE_FORCE_LOAD=y
CONFIG_MODULE_UNLOAD=y
CONFIG_MODULE_FORCE_UNLOAD=y
CONFIG_NET=y
CONFIG_PACKET=y
CONFIG_UNIX=y
CONFIG_INET=y
# CONFIG_IPV6 is not set
# CONFIG_WIRELESS is not set
# CONFIG_ETHTOOL_NETLINK is not set
CONFIG_DEVTMPFS=y
CONFIG_DEVTMPFS_MOUNT=y
CONFIG_BLK_DEV_LOOP=y
CONFIG_NETDEVICES=y
# CONFIG_ETHERNET is not set
CONFIG_USB_USBNET=y
# CONFIG_USB_NET_AX8817X is not set
# CONFIG_USB_NET_AX88179_178A is not set
# CONFIG_USB_NET_CDC_NCM is not set
# CONFIG_USB_NET_NET1080 is not set
CONFIG_USB_NET_RNDIS_HOST=y
# CONFIG_USB_BELKIN is not set
# CONFIG_USB_NET_ZAURUS is not set
# CONFIG_WLAN is not set
CONFIG_INPUT_FF_MEMLESS=y
CONFIG_INPUT_MOUSEDEV=m
CONFIG_INPUT_MOUSEDEV_SCREEN_X=320
CONFIG_INPUT_MOUSEDEV_SCREEN_Y=240
CONFIG_INPUT_JOYDEV=m
CONFIG_INPUT_EVDEV=m
CONFIG_KEYBOARD_ATKBD=m
CONFIG_KEYBOARD_MIYOO=y
CONFIG_MOUSE_PS2=m
CONFIG_MOUSE_SYNAPTICS_USB=m
CONFIG_INPUT_JOYSTICK=y
CONFIG_JOYSTICK_ANALOG=m
CONFIG_JOYSTICK_XPAD=m
CONFIG_JOYSTICK_XPAD_FF=y
CONFIG_INPUT_MISC=y
CONFIG_INPUT_UINPUT=m
CONFIG_SERIO_LIBPS2=y
CONFIG_GAMEPORT=y
CONFIG_LEGACY_PTY_COUNT=4
CONFIG_SERIAL_8250=y
CONFIG_SERIAL_8250_CONSOLE=y
CONFIG_SERIAL_8250_NR_UARTS=8
CONFIG_SERIAL_8250_RUNTIME_UARTS=8
CONFIG_SERIAL_8250_DW=y
CONFIG_SERIAL_OF_PLATFORM=y
# CONFIG_HW_RANDOM is not set
CONFIG_POWER_SUPPLY=y
CONFIG_BATTERY_MIYOO=y
# CONFIG_HWMON is not set
CONFIG_WATCHDOG=y
CONFIG_SUNXI_WATCHDOG=y
CONFIG_MFD_SYSCON=y
CONFIG_REGULATOR=y
CONFIG_REGULATOR_FIXED_VOLTAGE=y
# CONFIG_MEDIA_CEC_SUPPORT is not set
CONFIG_MEDIA_SUPPORT=y
# CONFIG_VIDEO_DEV is not set
# CONFIG_MEDIA_CONTROLLER is not set
# CONFIG_DVB_NET is not set
# CONFIG_DVB_DYNAMIC_MINORS is not set
CONFIG_FB=y
CONFIG_FB_MIYOO_VIDEO=y
CONFIG_FB_R61520=m
CONFIG_FB_GC9306=m
CONFIG_FB_ST7789S=m
CONFIG_FB_ST7789S_TE=m
CONFIG_FB_RM68090=m
CONFIG_FB_HX8347D=m
CONFIG_FB_TVOUT=m
CONFIG_BACKLIGHT_CLASS_DEVICE=y
CONFIG_BACKLIGHT_PWM=y
CONFIG_FRAMEBUFFER_CONSOLE=y
CONFIG_FRAMEBUFFER_CONSOLE_DETECT_PRIMARY=y
CONFIG_SOUND=m
CONFIG_SND=m
# CONFIG_SND_VERBOSE_PROCFS is not set
CONFIG_SND_ALOOP=m
# CONFIG_SND_ARM is not set
CONFIG_SND_SOC=m
CONFIG_SND_SUNIV_CODEC=m
CONFIG_USB=y
CONFIG_USB_DYNAMIC_MINORS=y
CONFIG_USB_OTG=y
CONFIG_USB_MUSB_HDRC=m
CONFIG_USB_MUSB_SUNXI=m
CONFIG_NOP_USB_XCEIV=y
CONFIG_USB_GADGET=y
CONFIG_USB_GADGET_VBUS_DRAW=500
CONFIG_USB_CONFIGFS=m
CONFIG_USB_CONFIGFS_ACM=y
CONFIG_USB_CONFIGFS_NCM=y
CONFIG_USB_CONFIGFS_ECM=y
CONFIG_USB_CONFIGFS_ECM_SUBSET=y
CONFIG_USB_CONFIGFS_RNDIS=y
CONFIG_USB_CONFIGFS_F_FS=y
CONFIG_USB_CONFIGFS_F_HID=y
CONFIG_MMC=y
CONFIG_MMC_SUNXI=y
CONFIG_STAGING=y
CONFIG_STAGING_MEDIA=y
CONFIG_VIDEO_SUNXI=y
CONFIG_VIDEO_SUNXI_CEDAR_VE=y
CONFIG_VIDEO_SUNXI_CEDAR_ION=y
# CONFIG_IOMMU_SUPPORT is not set
CONFIG_PWM=y
CONFIG_PWM_SUNIV=y
CONFIG_PHY_SUN4I_USB=m
CONFIG_NVMEM=y
CONFIG_NVMEM_SUNXI_SID=y
CONFIG_EXT4_FS=y
CONFIG_BTRFS_FS=m
CONFIG_VFAT_FS=y
CONFIG_TMPFS=y
CONFIG_CONFIGFS_FS=y
CONFIG_NLS_CODEPAGE_437=y
CONFIG_NLS_ISO8859_1=y
CONFIG_KEYS=y
# CONFIG_CRYPTO_MANAGER_DISABLE_TESTS is not set
CONFIG_CRYPTO_XXHASH=y
CONFIG_CRYPTO_BLAKE2B=y
CONFIG_CRYPTO_SHA256=y
CONFIG_CRYPTO_DRBG_MENU=y
# CONFIG_CRYPTO_HW is not set
CONFIG_LIBCRC32C=y
CONFIG_XZ_DEC=y
CONFIG_DMA_PERNUMA_CMA=y
CONFIG_CMA_SIZE_MBYTES=12
CONFIG_PRINTK_TIME=y
CONFIG_CONSOLE_LOGLEVEL_DEFAULT=4
# CONFIG_FTRACE is not set
```

## configs/miyoo_musl_defconfig
```kconfig
BR2_arm=y
BR2_SVN="svn"
BR2_CPAN_MIRROR="http://cpan.metacpan.org"
BR2_CCACHE=y
BR2_PER_PACKAGE_DIRECTORIES=y
# BR2_PIC_PIE is not set
BR2_SSP_NONE=y
BR2_RELRO_NONE=y
BR2_TOOLCHAIN_BUILDROOT_VENDOR="miyoo"
BR2_TOOLCHAIN_BUILDROOT_MUSL=y
BR2_KERNEL_HEADERS_4_9=y
BR2_GCC_VERSION_9_X=y
BR2_TOOLCHAIN_BUILDROOT_CXX=y
BR2_PACKAGE_HOST_GDB=y
BR2_PACKAGE_HOST_GDB_TUI=y
BR2_PACKAGE_HOST_GDB_PYTHON3=y
BR2_PACKAGE_HOST_GDB_SIM=y
BR2_TARGET_OPTIMIZATION="-fno-PIC -mcpu=arm926ej-s -marm"
BR2_TARGET_GENERIC_HOSTNAME="miyoo"
BR2_TARGET_GENERIC_ISSUE="Welcome to Miyoo"
# BR2_TARGET_GENERIC_REMOUNT_ROOTFS_RW is not set
BR2_ROOTFS_OVERLAY="board/miyoo/rootfs"
BR2_ROOTFS_PRE_BUILD_SCRIPT="board/miyoo/scripts/prebuild.sh"
BR2_ROOTFS_POST_IMAGE_SCRIPT="board/miyoo/scripts/genimage.sh"
BR2_ROOTFS_POST_SCRIPT_ARGS="${BR2_TOOLCHAIN_BUILDROOT_VENDOR} ${BR2_VERSION_FULL} ${BR2_TOOLCHAIN_BUILDROOT_LIBC} '${PACKAGES_TARGET}' '${PACKAGES_VERSION}'"
BR2_LINUX_KERNEL=y
BR2_LINUX_KERNEL_CUSTOM_GIT=y
BR2_LINUX_KERNEL_CUSTOM_REPO_URL="https://github.com/MiyooCFW/kernel.git"
BR2_LINUX_KERNEL_CUSTOM_REPO_VERSION="origin/master"
BR2_LINUX_KERNEL_DEFCONFIG="miyoo"
BR2_LINUX_KERNEL_DTS_SUPPORT=y
BR2_LINUX_KERNEL_INTREE_DTS_NAME="suniv-f1c100s-miyoo suniv-f1c100s-miyoo-4bit"
BR2_LINUX_KERNEL_INSTALL_TARGET=y
BR2_PACKAGE_BUSYBOX_CONFIG="board/miyoo/busybox.config"
BR2_PACKAGE_ALSA_UTILS=y
BR2_PACKAGE_ALSA_UTILS_APLAY=y
BR2_PACKAGE_ALSA_UTILS_SPEAKER_TEST=y
BR2_PACKAGE_ESPEAK=y
BR2_PACKAGE_ESPEAK_AUDIO_BACKEND_ALSA=y
BR2_PACKAGE_FFMPEG=y
BR2_PACKAGE_FFMPEG_GPL=y
BR2_PACKAGE_FFMPEG_NONFREE=y
BR2_PACKAGE_FFMPEG_FFPLAY=y
BR2_PACKAGE_FFMPEG_FFPROBE=y
BR2_PACKAGE_FFMPEG_AVRESAMPLE=y
BR2_PACKAGE_FFMPEG_POSTPROC=y
BR2_PACKAGE_MPG123=y
BR2_PACKAGE_VORBIS_TOOLS=y
BR2_PACKAGE_P7ZIP=y
BR2_PACKAGE_XZ=y
BR2_PACKAGE_ZIP=y
BR2_PACKAGE_GDB=y
BR2_PACKAGE_GDB_SERVER=y
BR2_PACKAGE_GDB_DEBUGGER=y
BR2_PACKAGE_GDB_TUI=y
BR2_PACKAGE_STRACE=y
BR2_PACKAGE_BINUTILS=y
BR2_PACKAGE_BINUTILS_TARGET=y
BR2_PACKAGE_GETTEXT=y
BR2_PACKAGE_LIBTOOL=y
BR2_PACKAGE_BTRFS_PROGS=y
BR2_PACKAGE_DOSFSTOOLS=y
BR2_PACKAGE_DOSFSTOOLS_FATLABEL=y
BR2_PACKAGE_DOSFSTOOLS_FSCK_FAT=y
BR2_PACKAGE_DOSFSTOOLS_MKFS_FAT=y
BR2_PACKAGE_FATRESIZE=y
BR2_PACKAGE_DEJAVU=y
BR2_PACKAGE_LIBERATION=y
BR2_PACKAGE_RETROARCH=y
BR2_PACKAGE_LIBRETRO_CORE_INFO=y
BR2_PACKAGE_LIBRETRO_2048=y
BR2_PACKAGE_LIBRETRO_81=y
BR2_PACKAGE_LIBRETRO_A5200=y
BR2_PACKAGE_LIBRETRO_ARDUOUS=y
BR2_PACKAGE_LIBRETRO_ATARI800=y
BR2_PACKAGE_LIBRETRO_BK_EMULATOR=y
BR2_PACKAGE_LIBRETRO_BLUEMSX=y
BR2_PACKAGE_LIBRETRO_CANNONBALL=y
BR2_PACKAGE_LIBRETRO_CAP32=y
BR2_PACKAGE_LIBRETRO_CHAILOVE=y
BR2_PACKAGE_LIBRETRO_DINOTHAWR=y
BR2_PACKAGE_LIBRETRO_ECWOLF=y
BR2_PACKAGE_LIBRETRO_FCEUMM=y
BR2_PACKAGE_LIBRETRO_FMSX=y
BR2_PACKAGE_LIBRETRO_FREECHAF=y
BR2_PACKAGE_LIBRETRO_FREEINTV=y
BR2_PACKAGE_LIBRETRO_FUSE=y
BR2_PACKAGE_LIBRETRO_GAMBATTE=y
BR2_PACKAGE_LIBRETRO_GEARBOY=y
BR2_PACKAGE_LIBRETRO_GEARCOLECO=y
BR2_PACKAGE_LIBRETRO_GEARSYSTEM=y
BR2_PACKAGE_LIBRETRO_GENESISPLUSGX=y
BR2_PACKAGE_LIBRETRO_GENESISPLUSGXWIDE=y
BR2_PACKAGE_LIBRETRO_GME=y
BR2_PACKAGE_LIBRETRO_GONG=y
BR2_PACKAGE_LIBRETRO_GPSP=y
BR2_PACKAGE_LIBRETRO_GW=y
BR2_PACKAGE_LIBRETRO_HANDY=y
BR2_PACKAGE_LIBRETRO_JAXE=y
BR2_PACKAGE_LIBRETRO_JUMPNBUMP=y
BR2_PACKAGE_LIBRETRO_LOWRES_NX=y
BR2_PACKAGE_LIBRETRO_LUTRO=y
BR2_PACKAGE_LIBRETRO_MAME2000=y
BR2_PACKAGE_LIBRETRO_MAME2003=y
BR2_PACKAGE_LIBRETRO_MAME2003_PLUS=y
BR2_PACKAGE_LIBRETRO_MEDNAFEN_PCE_FAST=y
BR2_PACKAGE_LIBRETRO_MEDNAFEN_WSWAN=y
BR2_PACKAGE_LIBRETRO_MGBA=y
BR2_PACKAGE_LIBRETRO_MINIVMAC=y
BR2_PACKAGE_LIBRETRO_MRBOOM=y
BR2_PACKAGE_LIBRETRO_NUMERO=y
BR2_PACKAGE_LIBRETRO_NXENGINE=y
BR2_PACKAGE_LIBRETRO_O2EM=y
BR2_PACKAGE_LIBRETRO_PCSX_REARMED=y
BR2_PACKAGE_LIBRETRO_PICODRIVE=y
BR2_PACKAGE_LIBRETRO_POCKETCDG=y
BR2_PACKAGE_LIBRETRO_POKEMINI=y
BR2_PACKAGE_LIBRETRO_POTATOR=y
BR2_PACKAGE_LIBRETRO_PRBOOM=y
BR2_PACKAGE_LIBRETRO_PROSYSTEM=y
BR2_PACKAGE_LIBRETRO_QUASI88=y
BR2_PACKAGE_LIBRETRO_QUICKNES=y
BR2_PACKAGE_LIBRETRO_RACE=y
BR2_PACKAGE_LIBRETRO_REMINISCENCE=y
BR2_PACKAGE_LIBRETRO_RETRO8=y
BR2_PACKAGE_LIBRETRO_SCUMMVM=y
BR2_PACKAGE_LIBRETRO_SMSPLUS=y
BR2_PACKAGE_LIBRETRO_SNES9X2002=y
BR2_PACKAGE_LIBRETRO_SNES9X2005=y
BR2_PACKAGE_LIBRETRO_STELLA2014=y
BR2_PACKAGE_LIBRETRO_THEODORE=y
BR2_PACKAGE_LIBRETRO_TIC80=y
BR2_PACKAGE_LIBRETRO_TYRQUAKE=y
BR2_PACKAGE_LIBRETRO_UW8=y
BR2_PACKAGE_LIBRETRO_VAPORSPEC=y
BR2_PACKAGE_LIBRETRO_VECX=y
BR2_PACKAGE_LIBRETRO_VEMULATOR=y
BR2_PACKAGE_LIBRETRO_WASM4=y
BR2_PACKAGE_LIBRETRO_X1=y
BR2_PACKAGE_LIBRETRO_XRICK=y
BR2_PACKAGE_DJVU=y
BR2_PACKAGE_FBGRAB=y
BR2_PACKAGE_MESA3D=y
BR2_PACKAGE_MESA3D_GALLIUM_DRIVER_SWRAST=y
BR2_PACKAGE_MESA3D_OPENGL_GLX=y
BR2_PACKAGE_SDL_GFX=y
BR2_PACKAGE_SDL_IMAGE_GIF=y
BR2_PACKAGE_SDL_IMAGE_LBM=y
BR2_PACKAGE_SDL_IMAGE_PCX=y
BR2_PACKAGE_SDL_IMAGE_PNM=y
BR2_PACKAGE_SDL_IMAGE_TARGA=y
BR2_PACKAGE_SDL_IMAGE_TIFF=y
BR2_PACKAGE_SDL_IMAGE_WEBP=y
BR2_PACKAGE_SDL_IMAGE_XCF=y
BR2_PACKAGE_SDL_IMAGE_XPM=y
BR2_PACKAGE_SDL_IMAGE_XV=y
BR2_PACKAGE_SDL_MIXER_MIDI_TIMIDITY=y
BR2_PACKAGE_SDL_NET=y
BR2_PACKAGE_SDL_SOUND=y
BR2_PACKAGE_SDL_SOUND_PLAYSOUND=y
BR2_PACKAGE_XORG7=y
BR2_PACKAGE_MUPDF=y
BR2_PACKAGE_DBUS=y
BR2_PACKAGE_JOYMAP=y
BR2_PACKAGE_LINUXCONSOLETOOLS=y
BR2_PACKAGE_LINUXCONSOLETOOLS_JOYSTICK=y
BR2_PACKAGE_PARTED=y
BR2_PACKAGE_UMTPRD=y
BR2_PACKAGE_LUA=y
BR2_PACKAGE_LUA_5_1=y
BR2_PACKAGE_LUA_ICONV=y
BR2_PACKAGE_PYTHON_KEYBOARD=y
BR2_PACKAGE_PYTHON_PYGAME=y
BR2_PACKAGE_PYTHON_PYGAME_IMAGE=y
BR2_PACKAGE_PYTHON_PYGAME_EXAMPLES=y
BR2_PACKAGE_PYTHON_PYGAME_FONT=y
BR2_PACKAGE_PYTHON_PYGAME_MIXER=y
BR2_PACKAGE_PYTHON_PYGAME_MENU=y
BR2_PACKAGE_LIBASPLIB=y
BR2_PACKAGE_LIBID3TAG=y
BR2_PACKAGE_LIBMAD=y
BR2_PACKAGE_LIBMIKMOD=y
BR2_PACKAGE_LIBSNDFILE=y
BR2_PACKAGE_OPENAL=y
BR2_PACKAGE_SPEEX=y
BR2_PACKAGE_TREMOR=y
BR2_PACKAGE_LIBZIP=y
BR2_PACKAGE_LZ4=y
BR2_PACKAGE_LIBSHA1=y
BR2_PACKAGE_SQLITE=y
BR2_PACKAGE_LIBCONFUSE=y
BR2_PACKAGE_BULLET=y
BR2_PACKAGE_GIFLIB=y
BR2_PACKAGE_LIBGLEW=y
BR2_PACKAGE_LIBGLU=y
BR2_PACKAGE_LIBSVG_CAIRO=y
BR2_PACKAGE_PANGO=y
BR2_PACKAGE_LIBPCIACCESS=y
BR2_PACKAGE_LIBUSBGX=y
BR2_PACKAGE_TSLIB=y
BR2_PACKAGE_JSON_C=y
BR2_PACKAGE_LIBXMLPP=y
BR2_PACKAGE_LIBXMLRPC=y
BR2_PACKAGE_TINYXML=y
BR2_PACKAGE_TINYXML2=y
BR2_PACKAGE_YAML_CPP=y
BR2_PACKAGE_LIBASS=y
BR2_PACKAGE_LIBTHEORA=y
BR2_PACKAGE_X264=y
BR2_PACKAGE_APR_UTIL=y
BR2_PACKAGE_ARGP_STANDALONE=y
BR2_PACKAGE_BOOST=y
BR2_PACKAGE_BOOST_CHRONO=y
BR2_PACKAGE_BOOST_CONTEXT=y
BR2_PACKAGE_BOOST_CONTRACT=y
BR2_PACKAGE_BOOST_DATE_TIME=y
BR2_PACKAGE_BOOST_EXCEPTION=y
BR2_PACKAGE_BOOST_GRAPH=y
BR2_PACKAGE_BOOST_GRAPH_PARALLEL=y
BR2_PACKAGE_BOOST_IOSTREAMS=y
BR2_PACKAGE_BOOST_JSON=y
BR2_PACKAGE_BOOST_LOCALE=y
BR2_PACKAGE_BOOST_MATH=y
BR2_PACKAGE_BOOST_MPI=y
BR2_PACKAGE_BOOST_NOWIDE=y
BR2_PACKAGE_BOOST_PROGRAM_OPTIONS=y
BR2_PACKAGE_BOOST_RANDOM=y
BR2_PACKAGE_BOOST_SERIALIZATION=y
BR2_PACKAGE_BOOST_STACKTRACE=y
BR2_PACKAGE_NCURSES_WCHAR=y
BR2_PACKAGE_UTF8PROC=y
BR2_PACKAGE_GMENU2X=y
BR2_PACKAGE_MIYOO_DAEMON=y
BR2_PACKAGE_MIYOO_LOGO=y
BR2_PACKAGE_MIYOO_CTL=y
BR2_PACKAGE_FBCAT=y
BR2_PACKAGE_ST_SDL=y
BR2_PACKAGE_COMMANDER=y
BR2_PACKAGE_SDLBOOK=y
BR2_PACKAGE_OPKG=y
BR2_PACKAGE_OPKG_UTILS=y
BR2_PACKAGE_DIALOG=y
BR2_PACKAGE_SCREEN=y
BR2_PACKAGE_UTIL_LINUX_LIBMOUNT=y
BR2_PACKAGE_UTIL_LINUX_PARTX=y
BR2_PACKAGE_NANO=y
BR2_TARGET_ROOTFS_BTRFS=y
BR2_TARGET_ROOTFS_BTRFS_LABEL="rootfs"
BR2_TARGET_ROOTFS_BTRFS_SIZE="256M"
# BR2_TARGET_ROOTFS_TAR is not set
BR2_TARGET_UBOOT=y
BR2_TARGET_UBOOT_BUILD_SYSTEM_KCONFIG=y
BR2_TARGET_UBOOT_CUSTOM_GIT=y
BR2_TARGET_UBOOT_CUSTOM_REPO_URL="https://github.com/MiyooCFW/uboot.git"
BR2_TARGET_UBOOT_CUSTOM_REPO_VERSION="origin/master"
BR2_TARGET_UBOOT_BOARD_DEFCONFIG="miyoo"
BR2_TARGET_UBOOT_NEEDS_DTC=y
BR2_TARGET_UBOOT_SPL=y
BR2_TARGET_UBOOT_SPL_NAME="u-boot-sunxi-with-spl.bin"
BR2_PACKAGE_HOST_DOSFSTOOLS=y
BR2_PACKAGE_HOST_E2FSPROGS=y
BR2_PACKAGE_HOST_GENIMAGE=y
BR2_PACKAGE_HOST_MTOOLS=y
BR2_PACKAGE_HOST_UBOOT_TOOLS=y
BR2_PACKAGE_HOST_UBOOT_TOOLS_FIT_SUPPORT=y
BR2_PACKAGE_HOST_UBOOT_TOOLS_FIT_SIGNATURE_SUPPORT=y
BR2_PACKAGE_HOST_UBOOT_TOOLS_BOOT_SCRIPT=y
BR2_PACKAGE_HOST_UBOOT_TOOLS_BOOT_SCRIPT_SOURCE="board/miyoo/boot.cmd"
```
