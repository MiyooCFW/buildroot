## package/libretro-fceumm/Config.in
```kconfig
config BR2_PACKAGE_LIBRETRO_FCEUMM
	bool "libretro-fceumm"
	depends on BR2_PACKAGE_RETROARCH
	help
	  A libretro NES emulator core for ARM.

	  http://www.libretro.com
```

## package/libretro-fmsx/Config.in
```kconfig
config BR2_PACKAGE_LIBRETRO_FMSX
	bool "libretro-fmsx"
	depends on BR2_PACKAGE_RETROARCH
	help
	  A libretro FMSX emulator core for ARM.

	  http://www.libretro.com
```

## package/libretro-freechaf/Config.in
```kconfig
config BR2_PACKAGE_LIBRETRO_FREECHAF
	bool "libretro-freechaf"
	depends on BR2_PACKAGE_RETROARCH
	help
	  A libretro Fairchild Channel F emulator core.

	  http://www.libretro.com
```

## package/libretro-freeintv/Config.in
```kconfig
config BR2_PACKAGE_LIBRETRO_FREEINTV
	bool "libretro-freeintv"
	depends on BR2_PACKAGE_RETROARCH
	help
	  A libretro Mattel Intellivision emulator core.

	  http://www.libretro.com
```

## package/libretro-fuse/Config.in
```kconfig
config BR2_PACKAGE_LIBRETRO_FUSE
	bool "libretro-fuse"
	depends on BR2_PACKAGE_RETROARCH
	help
	  A libretro ZX SPECTRUM emulator core.

	  http://www.libretro.com
```

## package/libretro-gearcoleco/Config.in
```kconfig
config BR2_PACKAGE_LIBRETRO_GEARCOLECO
	bool "libretro-gearcoleco"
	depends on BR2_PACKAGE_RETROARCH
	help
	  An accurate ColecoVision emulator.

	  http://www.libretro.com
```

## package/libretro-gearsystem/Config.in
```kconfig
config BR2_PACKAGE_LIBRETRO_GEARSYSTEM
	bool "libretro-gearsystem"
	depends on BR2_PACKAGE_RETROARCH
	help
	  A libretro SEGA 8 bits emulator core for ARM.

	  http://www.libretro.com
```

## package/libretro-gme/Config.in
```kconfig
config BR2_PACKAGE_LIBRETRO_GME
	bool "libretro-gme"
	depends on BR2_PACKAGE_RETROARCH
	help
	  A libretro port of gme, a game.

	  http://www.libretro.com
```

## package/libretro-gong/Config.in
```kconfig
config BR2_PACKAGE_LIBRETRO_GONG
	bool "libretro-gong"
	depends on BR2_PACKAGE_RETROARCH
	help
	  A libretro gong is a port of pong

	  https://github.com/libretro/gong
```

## package/libretro-gw/Config.in
```kconfig
config BR2_PACKAGE_LIBRETRO_GW
	bool "libretro-gw"
	depends on BR2_PACKAGE_RETROARCH
	help
	  A libretro core for Game & Watch simulators

	  http://www.libretro.com
```

## package/libretro-mrboom/Config.in
```kconfig
config BR2_PACKAGE_LIBRETRO_MRBOOM
	bool "libretro-mrboom"
	depends on BR2_PACKAGE_RETROARCH
	help
	  A libretro 8 players Bomberman clone.

	  http://www.libretro.com
```

## package/libretro-numero/Config.in
```kconfig
config BR2_PACKAGE_LIBRETRO_NUMERO
	bool "libretro-numero"
	depends on BR2_PACKAGE_RETROARCH
	help
	  A libretro port of numero, a game.

	  http://www.libretro.com
```

## package/libretro-nxengine/Config.in
```kconfig
config BR2_PACKAGE_LIBRETRO_NXENGINE
	bool "libretro-nxengine"
	depends on BR2_PACKAGE_RETROARCH
	help
	  NXEngine is a Cave Story game engine clone.

	  http://www.libretro.com
```

## package/libretro-o2em/Config.in
```kconfig
config BR2_PACKAGE_LIBRETRO_O2EM
	bool "libretro-o2em"
	depends on BR2_PACKAGE_RETROARCH
	help
	  A libretro Odyssey 2/VideoPac/VideoPac+ emulator core.

	  http://www.libretro.com
```

## package/libretro-picodrive/Config.in
```kconfig
config BR2_PACKAGE_LIBRETRO_PICODRIVE
	bool "libretro-picodrive"
	depends on BR2_PACKAGE_RETROARCH
	help
	  A libretro Megadrive SMS emulator core for ARM.

	  http://www.libretro.com
```

## package/libretro-pokemini/Config.in
```kconfig
config BR2_PACKAGE_LIBRETRO_POKEMINI
	bool "libretro-pokemini"
	depends on BR2_PACKAGE_RETROARCH
	help
	  A libretro Pokémon Mini emulator core.

	  http://www.libretro.com
```

## package/libretro-prboom/Config.in
```kconfig
config BR2_PACKAGE_LIBRETRO_PRBOOM
	bool "libretro-prboom"
	depends on BR2_PACKAGE_RETROARCH
	help
	  A libretro PrBoom core for ARM.

	  http://www.libretro.com
```

## package/libretro-quasi88/Config.in
```kconfig
config BR2_PACKAGE_LIBRETRO_QUASI88
	bool "libretro-quasi88"
	depends on BR2_PACKAGE_RETROARCH
	help
	  A libretro NEC PC-88 emulator core.

	  http://www.libretro.com
```

## package/libretro-quicknes/Config.in
```kconfig
config BR2_PACKAGE_LIBRETRO_QUICKNES
	bool "libretro-quicknes"
	depends on BR2_PACKAGE_RETROARCH
	help
	  A libretro NES emulator core for ARM.

	  http://www.libretro.com
```

## package/libretro-race/Config.in
```kconfig
config BR2_PACKAGE_LIBRETRO_RACE
	bool "libretro-race"
	depends on BR2_PACKAGE_RETROARCH
	help
	  A libretro NGP emulator core for ARM.

	  http://www.libretro.com
```

## package/libretro-retro8/Config.in
```kconfig
config BR2_PACKAGE_LIBRETRO_RETRO8
	bool "libretro-retro8"
	depends on BR2_PACKAGE_RETROARCH
	help
	  A libretro PICO-8 emulator core.

	  https://github.com/libretro/retro8
```

## package/libretro-smsplus/Config.in
```kconfig
config BR2_PACKAGE_LIBRETRO_SMSPLUS
	bool "libretro-smsplus"
	depends on BR2_PACKAGE_RETROARCH
	help
	  A libretro port of smsplus, a game.

	  http://www.libretro.com
```

## package/libretro-snes9x2005/Config.in
```kconfig
config BR2_PACKAGE_LIBRETRO_SNES9X2005
	bool "libretro-snes9x2005"
	depends on BR2_PACKAGE_RETROARCH
	help
	  A libretro SNES emulator core for ARM.

	  http://www.libretro.com
```

## package/libretro-stella2014/Config.in
```kconfig
config BR2_PACKAGE_LIBRETRO_STELLA2014
	bool "libretro-stella2014"
	depends on BR2_PACKAGE_RETROARCH
	help
	  A libretro Atari 2600 emulator core for ARM.

	  http://www.libretro.com
```

## package/libretro-super/Config.in
```kconfig
config BR2_PACKAGE_LIBRETRO_SUPER
    bool "libretro-super"
    depends on BR2_PACKAGE_RETROARCH
    depends on !BR2_PACKAGE_LIBRETRO_2048 && \
    !BR2_PACKAGE_LIBRETRO_81 && \
    !BR2_PACKAGE_LIBRETRO_A5200 && \
    !BR2_PACKAGE_LIBRETRO_ARDUOUS && \
    !BR2_PACKAGE_LIBRETRO_ATARI800 && \
    !BR2_PACKAGE_LIBRETRO_BK_EMULATOR && \
    !BR2_PACKAGE_LIBRETRO_BLUEMSX && \
    !BR2_PACKAGE_LIBRETRO_CANNONBALL && \
    !BR2_PACKAGE_LIBRETRO_CAP32 && \
    !BR2_PACKAGE_LIBRETRO_CHAILOVE && \
    !BR2_PACKAGE_LIBRETRO_CORE_INFO && \
    !BR2_PACKAGE_LIBRETRO_DINOTHAWR && \
    !BR2_PACKAGE_LIBRETRO_ECWOLF && \
    !BR2_PACKAGE_LIBRETRO_FCEUMM && \
    !BR2_PACKAGE_LIBRETRO_FMSX && \
    !BR2_PACKAGE_LIBRETRO_FREECHAF && \
    !BR2_PACKAGE_LIBRETRO_FREEINTV && \
    !BR2_PACKAGE_LIBRETRO_FUSE && \
    !BR2_PACKAGE_LIBRETRO_GAMBATTE && \
    !BR2_PACKAGE_LIBRETRO_GEARBOY && \
    !BR2_PACKAGE_LIBRETRO_GEARCOLECO && \
    !BR2_PACKAGE_LIBRETRO_GEARSYSTEM && \
    !BR2_PACKAGE_LIBRETRO_GENESISPLUSGX && \
    !BR2_PACKAGE_LIBRETRO_GENESISPLUSGXWIDE && \
    !BR2_PACKAGE_LIBRETRO_GME && \
    !BR2_PACKAGE_LIBRETRO_GONG && \
    !BR2_PACKAGE_LIBRETRO_GPSP && \
    !BR2_PACKAGE_LIBRETRO_GW && \
    !BR2_PACKAGE_LIBRETRO_HANDY && \
    !BR2_PACKAGE_LIBRETRO_JAXE && \
    !BR2_PACKAGE_LIBRETRO_JUMPNBUMP && \
    !BR2_PACKAGE_LIBRETRO_LOWRES_NX && \
    !BR2_PACKAGE_LIBRETRO_LUTRO && \
    !BR2_PACKAGE_LIBRETRO_MAME2000 && \
    !BR2_PACKAGE_LIBRETRO_MAME2003_PLUS && \
    !BR2_PACKAGE_LIBRETRO_MAME2003 && \
    !BR2_PACKAGE_LIBRETRO_MEDNAFEN_PCE_FAST && \
    !BR2_PACKAGE_LIBRETRO_MEDNAFEN_WSWAN && \
    !BR2_PACKAGE_LIBRETRO_MGBA && \
    !BR2_PACKAGE_LIBRETRO_MINIVMAC && \
    !BR2_PACKAGE_LIBRETRO_MRBOOM && \
    !BR2_PACKAGE_LIBRETRO_NUMERO && \
    !BR2_PACKAGE_LIBRETRO_NXENGINE && \
    !BR2_PACKAGE_LIBRETRO_O2EM && \
    !BR2_PACKAGE_LIBRETRO_PCSX_REARMED && \
    !BR2_PACKAGE_LIBRETRO_PICODRIVE && \
    !BR2_PACKAGE_LIBRETRO_POCKETCDG && \
    !BR2_PACKAGE_LIBRETRO_POKEMINI && \
    !BR2_PACKAGE_LIBRETRO_POTATOR && \
    !BR2_PACKAGE_LIBRETRO_PRBOOM && \
    !BR2_PACKAGE_LIBRETRO_PROSYSTEM && \
    !BR2_PACKAGE_LIBRETRO_QUASI88 && \
    !BR2_PACKAGE_LIBRETRO_QUICKNES && \
    !BR2_PACKAGE_LIBRETRO_RACE && \
    !BR2_PACKAGE_LIBRETRO_REMINISCENCE && \
    !BR2_PACKAGE_LIBRETRO_RETRO8 && \
    !BR2_PACKAGE_LIBRETRO_SMSPLUS && \
    !BR2_PACKAGE_LIBRETRO_SNES9X2002 && \
    !BR2_PACKAGE_LIBRETRO_SNES9X2005 && \
    !BR2_PACKAGE_LIBRETRO_STELLA2014 && \
    !BR2_PACKAGE_LIBRETRO_THEODORE && \
    !BR2_PACKAGE_LIBRETRO_TIC80 && \
    !BR2_PACKAGE_LIBRETRO_TYRQUAKE && \
    !BR2_PACKAGE_LIBRETRO_UW8 && \
    !BR2_PACKAGE_LIBRETRO_VAPORSPEC && \
    !BR2_PACKAGE_LIBRETRO_VECX && \
    !BR2_PACKAGE_LIBRETRO_VEMULATOR && \
    !BR2_PACKAGE_LIBRETRO_WASM4 && \
    !BR2_PACKAGE_LIBRETRO_X1 && \
    !BR2_PACKAGE_LIBRETRO_XRICK
    help
      Super repo for other libretro projects. Fetches, builds and installs.

      https://github.com/libretro/libretro-super
```
