## package/libretro-tic80/Config.in
```kconfig
config BR2_PACKAGE_LIBRETRO_TIC80
	bool "libretro-tic80"
	depends on BR2_PACKAGE_RETROARCH
	help
	  A libretro TIC-80 emulator core.

	  https://github.com/libretro/TIC-80.git
```

## package/libretro-tyrquake/Config.in
```kconfig
config BR2_PACKAGE_LIBRETRO_TYRQUAKE
	bool "libretro-tyrquake"
	depends on BR2_PACKAGE_RETROARCH
	help
	  A libretro Quake 1 core.

	  http://www.libretro.com
```

## package/libretro-uw8/Config.in
```kconfig
config BR2_PACKAGE_LIBRETRO_UW8
	bool "libretro-uw8"
	depends on BR2_PACKAGE_RETROARCH
	help
	  A libretro port of uw8, a game.

	  http://www.libretro.com
```

## package/libretro-wasm4/Config.in
```kconfig
config BR2_PACKAGE_LIBRETRO_WASM4
	bool "libretro-wasm4"
	depends on BR2_PACKAGE_RETROARCH
	help
	  WASM-4 is a game console that builds games with WebAssembly.

	  https://github.com/aduros/wasm4
```

## package/libretro-xrick/Config.in
```kconfig
config BR2_PACKAGE_LIBRETRO_XRICK
	bool "libretro-xrick"
	depends on BR2_PACKAGE_RETROARCH
	help
	  A libretro clone of Rick Dangerous.

	  http://www.libretro.com
```

## package/miyoo-daemon/Config.in
```kconfig
config BR2_PACKAGE_MIYOO_DAEMON
	bool "miyoo-daemon"
	depends on BR2_PACKAGE_SDL
	help
	  miyoo_daemon
```

## package/miyoo-logo/Config.in
```kconfig
config BR2_PACKAGE_MIYOO_LOGO
	bool "miyoo-logo"
	depends on BR2_PACKAGE_SDL
	depends on BR2_PACKAGE_MPG123
	help
	  miyoo_logo
```

## package/miyoo/Config.in
```kconfig
source "package/miyoo/gmenu2x/Config.in"
source "package/miyoo/gmenu2x-gm2xpkg/Config.in"
source "package/miyoo/miyoo-daemon/Config.in"
source "package/miyoo/miyoo-logo/Config.in"
source "package/miyoo/miyoo-ctl/Config.in"

menu "IPKs"
	source "package/miyoo/ipk-drpocketsnes/Config.in"
	source "package/miyoo/ipk-fceux/Config.in"
	source "package/miyoo/ipk-gngeo/Config.in"
	source "package/miyoo/ipk-gpsp/Config.in"
	source "package/miyoo/ipk-race/Config.in"
	source "package/miyoo/ipk-pcsx_rearmed/Config.in"
	source "package/miyoo/ipk-gambatte/Config.in"
endmenu

menu "RetroArch"
	source "package/miyoo/retroarch/Config.in"
endmenu
```

## package/miyoo/gmenu2x-skins/Config.in
```kconfig
config BR2_PACKAGE_GMENU2X_SKINS
	bool "gmenu2x-skins"
	depends on BR2_PACKAGE_GMENU2X
	help
	  These are GMenu2X's extra skins,fonts&icons (mixed licensing).
```

## package/miyoo/gmenu2x/Config.in
```kconfig
config BR2_PACKAGE_GMENU2X
	bool "gmenu2x"
	select BR2_PACKAGE_SDL
	select BR2_PACKAGE_SDL_IMAGE
	select BR2_PACKAGE_SDL_TTF
	help
	  This GMenu2X is a fork of GMenuNX and is developed for the MiyooCFW, released under the GNU GPL license v2.
```

## package/miyoo/ipk-gambatte/Config.in
```kconfig
config BR2_PACKAGE_IPK_GAMBATTE
    bool "Gambatte-dms IPK"
    help
      Gameboy emulator for handheld devices, using a modified Gambatte core (based on r572).
```

## package/miyoo/ipk-gpsp/Config.in
```kconfig
config BR2_PACKAGE_IPK_GPSP
    bool "gpSP IPK"
    help
      An enhanced version of gpSP for low-level ARM devices.
```

## package/miyoo/ipk-race/Config.in
```kconfig
config BR2_PACKAGE_IPK_RACE
    bool "RACE IPK"
    help
      Neo Geo Pocket and NGP Color emulator
```

## package/miyoo/miyoo-logo/Config.in
```kconfig
config BR2_PACKAGE_MIYOO_LOGO
	bool "miyoo-logo"
	select BR2_PACKAGE_SDL
	select BR2_PACKAGE_MPG123
	help
	  miyoo_logo
```

## package/miyoo/retroarch/Config.in
```kconfig
config BR2_PACKAGE_RETROARCH
    bool "retroarch"
    select BR2_PACKAGE_LIBRETRO_RETROARCH
    depends on !BR2_STATIC_LIBS
    help
      This option enables the libretro framework. Sub-options allow to
      select which modules or cores should be built.

if BR2_PACKAGE_RETROARCH
source "package/miyoo/retroarch/libretro-retroarch/Config.in"
source "package/miyoo/retroarch/libretro-assets/Config.in"
source "package/miyoo/retroarch/libretro-database/Config.in"
source "package/miyoo/retroarch/libretro-super/Config.in"
source "package/miyoo/retroarch/libretro-core-info/Config.in"
source "package/miyoo/retroarch/libretro-2048/Config.in"
source "package/miyoo/retroarch/libretro-81/Config.in"
source "package/miyoo/retroarch/libretro-a5200/Config.in"
source "package/miyoo/retroarch/libretro-arduous/Config.in"
source "package/miyoo/retroarch/libretro-atari800/Config.in"
source "package/miyoo/retroarch/libretro-bk-emulator/Config.in"
source "package/miyoo/retroarch/libretro-bluemsx/Config.in"
source "package/miyoo/retroarch/libretro-cannonball/Config.in"
source "package/miyoo/retroarch/libretro-cap32/Config.in"
source "package/miyoo/retroarch/libretro-chailove/Config.in"
source "package/miyoo/retroarch/libretro-dinothawr/Config.in"
source "package/miyoo/retroarch/libretro-ecwolf/Config.in"
source "package/miyoo/retroarch/libretro-fceumm/Config.in"
source "package/miyoo/retroarch/libretro-fmsx/Config.in"
source "package/miyoo/retroarch/libretro-freechaf/Config.in"
source "package/miyoo/retroarch/libretro-freeintv/Config.in"
source "package/miyoo/retroarch/libretro-fuse/Config.in"
source "package/miyoo/retroarch/libretro-gambatte/Config.in"
source "package/miyoo/retroarch/libretro-gearboy/Config.in"
source "package/miyoo/retroarch/libretro-gearcoleco/Config.in"
source "package/miyoo/retroarch/libretro-gearsystem/Config.in"
source "package/miyoo/retroarch/libretro-genesisplusgx/Config.in"
source "package/miyoo/retroarch/libretro-genesisplusgxwide/Config.in"
source "package/miyoo/retroarch/libretro-gme/Config.in"
source "package/miyoo/retroarch/libretro-gong/Config.in"
source "package/miyoo/retroarch/libretro-gpsp/Config.in"
source "package/miyoo/retroarch/libretro-gw/Config.in"
source "package/miyoo/retroarch/libretro-handy/Config.in"
source "package/miyoo/retroarch/libretro-jaxe/Config.in"
source "package/miyoo/retroarch/libretro-jumpnbump/Config.in"
source "package/miyoo/retroarch/libretro-lowres-nx/Config.in"
source "package/miyoo/retroarch/libretro-lutro/Config.in"
source "package/miyoo/retroarch/libretro-mame2000/Config.in"
source "package/miyoo/retroarch/libretro-mame2003/Config.in"
source "package/miyoo/retroarch/libretro-mame2003-plus/Config.in"
source "package/miyoo/retroarch/libretro-mednafen-pce-fast/Config.in"
source "package/miyoo/retroarch/libretro-mednafen-wswan/Config.in"
source "package/miyoo/retroarch/libretro-mgba/Config.in"
source "package/miyoo/retroarch/libretro-minivmac/Config.in"
source "package/miyoo/retroarch/libretro-mrboom/Config.in"
source "package/miyoo/retroarch/libretro-numero/Config.in"
source "package/miyoo/retroarch/libretro-nxengine/Config.in"
source "package/miyoo/retroarch/libretro-o2em/Config.in"
source "package/miyoo/retroarch/libretro-pcsx_rearmed/Config.in"
source "package/miyoo/retroarch/libretro-picodrive/Config.in"
source "package/miyoo/retroarch/libretro-pocketcdg/Config.in"
source "package/miyoo/retroarch/libretro-pokemini/Config.in"
source "package/miyoo/retroarch/libretro-potator/Config.in"
source "package/miyoo/retroarch/libretro-prboom/Config.in"
source "package/miyoo/retroarch/libretro-prosystem/Config.in"
source "package/miyoo/retroarch/libretro-quasi88/Config.in"
source "package/miyoo/retroarch/libretro-quicknes/Config.in"
source "package/miyoo/retroarch/libretro-race/Config.in"
source "package/miyoo/retroarch/libretro-reminiscence/Config.in"
source "package/miyoo/retroarch/libretro-retro8/Config.in"
source "package/miyoo/retroarch/libretro-scummvm/Config.in"
source "package/miyoo/retroarch/libretro-smsplus/Config.in"
source "package/miyoo/retroarch/libretro-snes9x2002/Config.in"
source "package/miyoo/retroarch/libretro-snes9x2005/Config.in"
source "package/miyoo/retroarch/libretro-stella2014/Config.in"
source "package/miyoo/retroarch/libretro-theodore/Config.in"
source "package/miyoo/retroarch/libretro-tic80/Config.in"
source "package/miyoo/retroarch/libretro-tyrquake/Config.in"
source "package/miyoo/retroarch/libretro-uw8/Config.in"
source "package/miyoo/retroarch/libretro-vaporspec/Config.in"
source "package/miyoo/retroarch/libretro-vecx/Config.in"
source "package/miyoo/retroarch/libretro-vemulator/Config.in"
source "package/miyoo/retroarch/libretro-wasm4/Config.in"
source "package/miyoo/retroarch/libretro-x1/Config.in"
source "package/miyoo/retroarch/libretro-xrick/Config.in"
endif
```

## package/miyoo/retroarch/libretro-2048/Config.in
```kconfig
config BR2_PACKAGE_LIBRETRO_2048
	bool "libretro-2048"
	depends on BR2_PACKAGE_RETROARCH
	help
	  A libretro port of 2048, a game.

	  http://www.libretro.com
```

## package/miyoo/retroarch/libretro-81/Config.in
```kconfig
config BR2_PACKAGE_LIBRETRO_81
	bool "libretro-81"
	depends on BR2_PACKAGE_RETROARCH
	help
	  A libretro EightyOne ZX81 emulator core.

	  http://www.libretro.com
```

## package/miyoo/retroarch/libretro-a5200/Config.in
```kconfig
config BR2_PACKAGE_LIBRETRO_A5200
	bool "libretro-a5200"
	depends on BR2_PACKAGE_RETROARCH
	help
	  A libretro ATARI5200 emulator core.

	  http://www.libretro.com
```

## package/miyoo/retroarch/libretro-assets/Config.in
```kconfig
config BR2_PACKAGE_LIBRETRO_ASSETS
    bool "retroarch assets"
    depends on BR2_PACKAGE_RETROARCH
    help
    The retroarch-assets repository is the home of the user interface elements used to generate the various User Experience (UX) environments.
    The UX environments are referred as "menu drivers" and you can switch between environments on most platforms at any time.

      https://github.com/libretro/libretro-assets
```

## package/miyoo/retroarch/libretro-atari800/Config.in
```kconfig
config BR2_PACKAGE_LIBRETRO_ATARI800
	bool "libretro-atari800"
	depends on BR2_PACKAGE_RETROARCH
	help
	  A libretro ATARI800 E ATARI5200 emulator core.

	  http://www.libretro.com
```

## package/miyoo/retroarch/libretro-bk-emulator/Config.in
```kconfig
config BR2_PACKAGE_LIBRETRO_BK_EMULATOR
	bool "libretro-bk-emulator"
	depends on BR2_PACKAGE_RETROARCH
	help
	  A libretro BK computer serie emulator core.

	  http://www.libretro.com
```

## package/miyoo/retroarch/libretro-cannonball/Config.in
```kconfig
config BR2_PACKAGE_LIBRETRO_CANNONBALL
	bool "libretro-cannonball"
	depends on BR2_PACKAGE_RETROARCH
	help
	  Cannonball: An Enhanced OutRun Engine.

	  http://www.libretro.com
```

## package/miyoo/retroarch/libretro-cap32/Config.in
```kconfig
config BR2_PACKAGE_LIBRETRO_CAP32
	bool "libretro-cap32"
	depends on BR2_PACKAGE_RETROARCH
	help
	  A libretro AMSTRAD CPC(+) emulator core.

	  http://www.libretro.com
```
