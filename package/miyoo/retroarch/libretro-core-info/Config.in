## package/miyoo/retroarch/libretro-core-info/Config.in
```kconfig
config BR2_PACKAGE_LIBRETRO_CORE_INFO
    bool "libretro-core-info"
    depends on BR2_PACKAGE_RETROARCH
    help
      libretro's core info files
      https://github.com/libretro/libretro-core-info
```

## package/miyoo/retroarch/libretro-dcastaway/Config.in
```kconfig
config BR2_PACKAGE_LIBRETRO_DCASTAWAY
	bool "libretro-dcastaway"
	depends on BR2_PACKAGE_RETROARCH
	help
	  A fast libretro ATARI-ST emulator core.

	  https://github.com/Apaczer/DCaSTaway
```

## package/miyoo/retroarch/libretro-dinothawr/Config.in
```kconfig
config BR2_PACKAGE_LIBRETRO_DINOTHAWR
	bool "libretro-dinothawr"
	depends on BR2_PACKAGE_RETROARCH
	help
	  A libretro block pushing puzzle game.

	  http://www.libretro.com
```

## package/miyoo/retroarch/libretro-fake08/Config.in
```kconfig
config BR2_PACKAGE_LIBRETRO_FAKE08
	bool "libretro-fake08"
	depends on BR2_PACKAGE_RETROARCH
	depends on BR2_INSTALL_LIBSTDCPP
	help
	  A libretro PICO-8 emulator core.

	  https://github.com/jtothebell/fake-08

comment "LIBRETRO_FAKE08 needs a toolchain w/ C++"
	depends on !BR2_INSTALL_LIBSTDCPP
```

## package/miyoo/retroarch/libretro-frodo/Config.in
```kconfig
config BR2_PACKAGE_LIBRETRO_FRODO
	bool "libretro-frodo"
	depends on BR2_PACKAGE_RETROARCH
	help
	  A fast libretro COMMODORE 64 emulator core.

	  https://github.com/Apaczer/frodo4/tree/libretro
```

## package/miyoo/retroarch/libretro-gambatte/Config.in
```kconfig
config BR2_PACKAGE_LIBRETRO_GAMBATTE
	bool "libretro-gambatte"
	depends on BR2_PACKAGE_RETROARCH
	help
	  A libretro GAMEBOY emulator core for ARM.

	  http://www.libretro.com
```

## package/miyoo/retroarch/libretro-gearboy/Config.in
```kconfig
config BR2_PACKAGE_LIBRETRO_GEARBOY
	bool "libretro-gearboy"
	depends on BR2_PACKAGE_RETROARCH
	help
	  A libretro port of Gearboy, a game.

	  http://www.libretro.com
```

## package/miyoo/retroarch/libretro-genesisplusgx/Config.in
```kconfig
config BR2_PACKAGE_LIBRETRO_GENESISPLUSGX
	bool "libretro-genesisplusgx"
	depends on BR2_PACKAGE_RETROARCH
	help
	  A libretro SEGA 8 / 16 bits emulator core for ARM.

	  http://www.libretro.com
```

## package/miyoo/retroarch/libretro-genesisplusgxwide/Config.in
```kconfig
config BR2_PACKAGE_LIBRETRO_GENESISPLUSGXWIDE
	bool "libretro-genesisplusgxwide"
	depends on BR2_PACKAGE_RETROARCH
	help
	  A libretro SEGA 8 / 16 bits emulator core for ARM,
	  with wide screen support

	  https://github.com/libretro/Genesis-Plus-GX-Wide
```

## package/miyoo/retroarch/libretro-gpsp/Config.in
```kconfig
config BR2_PACKAGE_LIBRETRO_GPSP
	bool "libretro-gpsp"
	depends on BR2_PACKAGE_RETROARCH
	help
	  A libretro GBA emulator core for ARM.

	  http://www.libretro.com
```

## package/miyoo/retroarch/libretro-handy/Config.in
```kconfig
config BR2_PACKAGE_LIBRETRO_HANDY
	bool "libretro-handy"
	depends on BR2_PACKAGE_RETROARCH
	help
	  A libretro Lynx emulator core for ARM.

	  http://www.libretro.com
```

## package/miyoo/retroarch/libretro-jaxe/Config.in
```kconfig
config BR2_PACKAGE_LIBRETRO_JAXE
	bool "libretro-jaxe"
	depends on BR2_PACKAGE_RETROARCH
	help
	  A libretro port of Jaxe, a game.

	  http://www.libretro.com
```

## package/miyoo/retroarch/libretro-jumpnbump/Config.in
```kconfig
config BR2_PACKAGE_LIBRETRO_JUMPNBUMP
	bool "libretro-jumpnbump"
	depends on BR2_PACKAGE_RETROARCH
	help
	  A libretro port of jumpnbump, a game.

	  http://www.libretro.com
```

## package/miyoo/retroarch/libretro-lowres-nx/Config.in
```kconfig
config BR2_PACKAGE_LIBRETRO_LOWRES_NX
	bool "libretro-lowres-nx"
	depends on BR2_PACKAGE_RETROARCH
	help
	  A libretro Virtual Game Console LowRes-NX emulator core.

	  https://github.com/timoinutilis/lowres-nx
```

## package/miyoo/retroarch/libretro-lutro/Config.in
```kconfig
config BR2_PACKAGE_LIBRETRO_LUTRO
	bool "libretro-lutro"
	depends on BR2_PACKAGE_RETROARCH
	help
	  An experimental lua game framework for libretro.

	  http://www.libretro.com
```

## package/miyoo/retroarch/libretro-mame2000/Config.in
```kconfig
config BR2_PACKAGE_LIBRETRO_MAME2000
	bool "libretro-mame2000"
	depends on BR2_PACKAGE_RETROARCH
	help
	  A libretro mame2000 core for ARM.

	  http://www.libretro.com
```

## package/miyoo/retroarch/libretro-mame2003/Config.in
```kconfig
config BR2_PACKAGE_LIBRETRO_MAME2003
	bool "libretro-mame2003"
	depends on BR2_PACKAGE_RETROARCH
	help
	  A libretro mame2003 core for ARM.

	  http://www.libretro.com
```

## package/miyoo/retroarch/libretro-mednafen-pce-fast/Config.in
```kconfig
config BR2_PACKAGE_LIBRETRO_MEDNAFEN_PCE_FAST
	bool "libretro-mednafen-pce-fast"
	depends on BR2_PACKAGE_RETROARCH
	help
	  A libretro port of mednafen-pce-fast, a game.

	  http://www.libretro.com
```

## package/miyoo/retroarch/libretro-mednafen-supergrafx/Config.in
```kconfig
config BR2_PACKAGE_LIBRETRO_MEDNAFEN_SUPERGRAFX
	bool "libretro-mednafen-supergrafx"
	depends on BR2_PACKAGE_RETROARCH
	depends on BR2_INSTALL_LIBSTDCPP
	help
	  A libretro Supergrafx emulator core for ARM.

	  http://www.libretro.com

comment "LIBRETRO_MEDNAFEN_SUPERGRAFX needs a toolchain w/ C++"
	depends on !BR2_INSTALL_LIBSTDCPP
```

## package/miyoo/retroarch/libretro-mednafen-wswan/Config.in
```kconfig
config BR2_PACKAGE_LIBRETRO_MEDNAFEN_WSWAN
	bool "libretro-mednafen-wswan"
	depends on BR2_PACKAGE_RETROARCH
	help
	  A libretro port of mednafen-wswan, a game.

	  http://www.libretro.com
```

## package/miyoo/retroarch/libretro-mgba/Config.in
```kconfig
config BR2_PACKAGE_LIBRETRO_MGBA
	bool "libretro-mgba"
	depends on BR2_PACKAGE_RETROARCH
	help
	  A libretro GBA emulator core for ARM.

	  http://www.libretro.com
```

## package/miyoo/retroarch/libretro-minivmac/Config.in
```kconfig
config BR2_PACKAGE_LIBRETRO_MINIVMAC
	bool "libretro-minivmac"
	depends on BR2_PACKAGE_RETROARCH
	help
	  A libretro MACINTOSH emulator core.

	  http://www.libretro.com
```

## package/miyoo/retroarch/libretro-pcsx_rearmed/Config.in
```kconfig
config BR2_PACKAGE_LIBRETRO_PCSX_REARMED
	bool "libretro-pcsx_rearmed"
	depends on BR2_PACKAGE_RETROARCH
	help
	  A libretro psx emulator core for ARM.

	  http://www.libretro.com
```

## package/miyoo/retroarch/libretro-pocketcdg/Config.in
```kconfig
config BR2_PACKAGE_LIBRETRO_POCKETCDG
	bool "libretro-pocketcdg"
	depends on BR2_PACKAGE_RETROARCH
	help
	  A libretro port of pocketcdg, a game.

	  http://www.libretro.com
```

## package/miyoo/retroarch/libretro-potator/Config.in
```kconfig
config BR2_PACKAGE_LIBRETRO_POTATOR
	bool "libretro-potator"
	depends on BR2_PACKAGE_RETROARCH
	help
	  A libretro Watara Supervision emulator core.

	  http://www.libretro.com
```
