## package/miyoo/retroarch/libretro-prosystem/Config.in
```kconfig
config BR2_PACKAGE_LIBRETRO_PROSYSTEM
	bool "libretro-prosystem"
	depends on BR2_PACKAGE_RETROARCH
	help
	  A libretro ATARI 7800 emulator for ARM.

	  http://www.libretro.com
```

## package/miyoo/retroarch/libretro-reminiscence/Config.in
```kconfig
config BR2_PACKAGE_LIBRETRO_REMINISCENCE
	bool "libretro-reminiscence"
	depends on BR2_PACKAGE_RETROARCH
	help
	  A libretro Flashback engine reimplementation.

	  http://www.libretro.com
```

## package/miyoo/retroarch/libretro-retroarch/Config.in
```kconfig
config BR2_PACKAGE_LIBRETRO_RETROARCH
    bool "libretro-retroarch"
    depends on BR2_PACKAGE_RETROARCH
    select BR2_PACKAGE_LIBRETRO_DATABASE
    select BR2_PACKAGE_LIBRETRO_ASSETS
    help
      RetroArch is the reference frontend for the libretro API.
      Popular examples of implementations for this API includes
      video game system emulators and game engines as well as
      more generalized 3D programs. These programs are
      instantiated as dynamic libraries.
      We refer to these as "libretro cores".

      https://github.com/libretro/RetroArch
```

## package/miyoo/retroarch/libretro-scummvm-legacy/Config.in
```kconfig
config BR2_PACKAGE_LIBRETRO_SCUMMVM_LEGACY
	bool "libretro-scummvm-legacy"
	depends on BR2_PACKAGE_RETROARCH
	help
	  A libretro SCUMMVM emulator - legacy version.

	  http://www.libretro.com
```

## package/miyoo/retroarch/libretro-scummvm/Config.in
```kconfig
config BR2_PACKAGE_LIBRETRO_SCUMMVM
	bool "libretro-scummvm"
	depends on BR2_PACKAGE_RETROARCH
	help
	  A libretro SCUMMVM emulator core for ARM.

	  http://www.libretro.com
```

## package/miyoo/retroarch/libretro-snes9x2002/Config.in
```kconfig
config BR2_PACKAGE_LIBRETRO_SNES9X2002
	bool "libretro-snes9x2002"
	depends on BR2_PACKAGE_RETROARCH
	help
	  A libretro SNES emulator core for ARM.

	  http://www.libretro.com
```

## package/miyoo/retroarch/libretro-theodore/Config.in
```kconfig
config BR2_PACKAGE_LIBRETRO_THEODORE
	bool "libretro-theodore"
	depends on BR2_PACKAGE_RETROARCH
	help
	  A libretro Thomson TO8 emulator core.

	  https://github.com/Zlika/theodore
```

## package/miyoo/retroarch/libretro-uae4all/Config.in
```kconfig
config BR2_PACKAGE_LIBRETRO_UAE4ALL
	bool "libretro-uae4all"
	depends on BR2_PACKAGE_RETROARCH
	help
	  A fast libretro AMIGA 500 emulator core.

	  https://github.com/Apaczer/uae4all/tree/libretro
```

## package/miyoo/retroarch/libretro-vaporspec/Config.in
```kconfig
config BR2_PACKAGE_LIBRETRO_VAPORSPEC
	bool "libretro-vaporspec"
	depends on BR2_PACKAGE_RETROARCH
	help
	  A libretro port of vaporspec, a game.

	  http://www.libretro.com
```

## package/miyoo/retroarch/libretro-vecx/Config.in
```kconfig
config BR2_PACKAGE_LIBRETRO_VECX
	bool "libretro-vecx"
	depends on BR2_PACKAGE_RETROARCH
	help
	  A libretro Vectrex emulator core for ARM.

	  http://www.libretro.com
```

## package/miyoo/retroarch/libretro-vemulator/Config.in
```kconfig
config BR2_PACKAGE_LIBRETRO_VEMULATOR
	bool "libretro-vemulator"
	depends on BR2_PACKAGE_RETROARCH
	help
	  A libretro port of vemulator, a game.

	  http://www.libretro.com
```

## package/miyoo/retroarch/libretro-x1/Config.in
```kconfig
config BR2_PACKAGE_LIBRETRO_X1
	bool "libretro-x1"
	depends on BR2_PACKAGE_RETROARCH
	help
	  A libretro port of x1, a game.

	  http://www.libretro.com
```

## package/miyoo/sdlbook/Config.in
```kconfig
config BR2_PACKAGE_SDLBOOK
	bool "sdlbook"
	select BR2_PACKAGE_MUPDF
	select BR2_PACKAGE_DJVU
	select BR2_PACKAGE_TIFF
	help
	  Simple djvu/pdf/epub ebook viewer based on djvulibre,
	  libmupdf and SDL 1.2
```

## package/miyoo/shellect/Config.in
```kconfig
config BR2_PACKAGE_SHELLECT
	bool "shellect"
	help
	  Selection menu written in POSIX shell.
```

## package/python-keyboard/Config.in
```kconfig
config BR2_PACKAGE_PYTHON_KEYBOARD
	select BR2_PACKAGE_KBD
	bool "python-keyboard"
	help
	  Hook and simulate keyboard events on Windows and Linux
	  https://pypi.org/project/keyboard
```

## package/python-pygame-menu/Config.in
```kconfig
config BR2_PACKAGE_PYTHON_PYGAME_MENU
	bool "python-pygame-menu"
	select BR2_PACKAGE_PYTHON_TYPING_EXTENSIONS # runtime
	depends on BR2_PACKAGE_PYTHON_PYGAME
	help
	  A menu for pygame to generate GUI/MENU. Simple&easy to use
	  https://pypi.org/project/pygame-menu/
```

## package/sdlbook/Config.in
```kconfig
config BR2_PACKAGE_SDLBOOK
	bool "sdlbook"
	help
	  Simple djvu/pdf/epub ebook viewer based on djvulibre,
	  libmupdf and SDL 1.2
```
