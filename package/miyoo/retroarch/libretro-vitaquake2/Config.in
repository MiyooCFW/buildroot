## package/miyoo/retroarch/libretro-vitaquake2/Config.in
```kconfig
config BR2_PACKAGE_LIBRETRO_VITAQUAKE2
	bool "libretro-vitaquake2"
	depends on BR2_PACKAGE_RETROARCH
	help
	  A libretro quake2 core.

	  https://github.com/libretro/vitaquake2
```
